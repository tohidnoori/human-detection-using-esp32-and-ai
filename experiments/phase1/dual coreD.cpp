#include <Arduino.h>
#include <math.h>
#include "esp_timer.h"
#include "freertos/FreeRTOS.h"
#include "freertos/task.h"

// ============================================================
// Experiment D
// Parallel DBSCAN Cluster Expansion
//
// Baseline:
//   Single-Core Spatial Grid DBSCAN
//
// Dual-Core:
//   Spatial Grid
//        +
//   Parallel Cluster Expansion
//
// Core 0:
//   Main benchmark + first half of frontier
//
// Core 1:
//   Second half of frontier
//
// Shared labels are protected by a cross-core critical section.
// No NxN distance matrix is used.
// ============================================================


// ============================================================
// Configuration
// ============================================================

#define MAX_N 1440
#define GRID_BUCKETS 2048

const float EPSILON = 0.20f;
const float EPSILON2 = EPSILON * EPSILON;

const int MIN_PTS = 5;

const float CLUSTER_RADIUS = 0.60f;

// Below this frontier size, synchronization overhead is
// likely larger than the parallel benefit.
const int PARALLEL_THRESHOLD = 8;


// ============================================================
// Data structures
// ============================================================

struct Point3D
{
    float x;
    float y;
    float z;
};

struct DBSCANStats
{
    int clusters;
    int core;
    int border;
    int noise;
};


// ============================================================
// Main buffers
// ============================================================

Point3D *points = nullptr;

int *baselineLabels = nullptr;
int *dualLabels = nullptr;

uint8_t *coreFlags = nullptr;

int *baselineQueue = nullptr;

int *dualQueue = nullptr;

// Separate next-frontier buffers
// Core 0 -> dualNext0
// Core 1 -> dualNext1
int *dualNext0 = nullptr;
int *dualNext1 = nullptr;


// ============================================================
// Spatial Grid
// ============================================================

int *gridHead = nullptr;
int *gridNext = nullptr;

int *cellX = nullptr;
int *cellY = nullptr;
int *cellZ = nullptr;


// ============================================================
// Core 1 worker
// ============================================================

TaskHandle_t workerHandle = nullptr;
TaskHandle_t experimentHandle = nullptr;

// Portion of current frontier handled by Core 1
volatile int workerStart = 0;
volatile int workerEnd = 0;

// Cluster currently being expanded
volatile int workerClusterId = 0;

// Pointer to current frontier
int *workerFrontier = nullptr;

// Number of points generated by Core 1
volatile int workerNextSize = 0;


// ============================================================
// Cross-core label lock
// ============================================================

portMUX_TYPE labelMux =
    portMUX_INITIALIZER_UNLOCKED;


// ============================================================
// Deterministic random generator
// ============================================================

uint32_t rngState = 123456789;


// ============================================================
// Random generator
// ============================================================

uint32_t nextRandom()
{
    rngState ^= rngState << 13;
    rngState ^= rngState >> 17;
    rngState ^= rngState << 5;

    return rngState;
}


float randomFloat(
    float minValue,
    float maxValue
)
{
    float r =
        (nextRandom() % 1000000) /
        1000000.0f;

    return minValue +
           r * (maxValue - minValue);
}


// ============================================================
// Squared distance
// ============================================================

inline float squaredDistance(
    const Point3D &a,
    const Point3D &b
)
{
    float dx = a.x - b.x;
    float dy = a.y - b.y;
    float dz = a.z - b.z;

    return dx * dx +
           dy * dy +
           dz * dz;
}


// ============================================================
// Dataset generation
// ============================================================

void generateDataset(int N)
{
    rngState = 123456789;

    const Point3D centers[3] =
    {
        {0.0f, 0.0f, 0.0f},
        {5.0f, 5.0f, 5.0f},
        {10.0f, 0.0f, 5.0f}
    };

    int perCluster =
        N / 3;

    for (int i = 0; i < N; i++)
    {
        int cluster =
            i / perCluster;

        if (cluster > 2)
        {
            cluster = 2;
        }

        points[i].x =
            centers[cluster].x +
            randomFloat(
                -CLUSTER_RADIUS,
                CLUSTER_RADIUS
            );

        points[i].y =
            centers[cluster].y +
            randomFloat(
                -CLUSTER_RADIUS,
                CLUSTER_RADIUS
            );

        points[i].z =
            centers[cluster].z +
            randomFloat(
                -CLUSTER_RADIUS,
                CLUSTER_RADIUS
            );
    }
}


// ============================================================
// Spatial hash
// ============================================================

inline uint32_t gridHash(
    int x,
    int y,
    int z
)
{
    uint32_t h =
        (uint32_t)(x * 73856093);

    h ^=
        (uint32_t)(y * 19349663);

    h ^=
        (uint32_t)(z * 83492791);

    return h % GRID_BUCKETS;
}


// ============================================================
// Cell coordinate
// ============================================================

inline int getCellCoordinate(
    float value
)
{
    return (int)floorf(
        value / EPSILON
    );
}


// ============================================================
// Clear grid
// ============================================================

void clearGrid()
{
    for (int i = 0;
         i < GRID_BUCKETS;
         i++)
    {
        gridHead[i] = -1;
    }
}


// ============================================================
// Build grid
// ============================================================

void buildGrid(int N)
{
    clearGrid();

    for (int i = 0;
         i < N;
         i++)
    {
        int x =
            getCellCoordinate(
                points[i].x
            );

        int y =
            getCellCoordinate(
                points[i].y
            );

        int z =
            getCellCoordinate(
                points[i].z
            );

        cellX[i] = x;
        cellY[i] = y;
        cellZ[i] = z;

        uint32_t hash =
            gridHash(
                x,
                y,
                z
            );

        gridNext[i] =
            gridHead[hash];

        gridHead[hash] =
            i;
    }
}


// ============================================================
// Count neighbors using spatial grid
// ============================================================

int gridCountNeighbors(
    int index
)
{
    int cx = cellX[index];
    int cy = cellY[index];
    int cz = cellZ[index];

    int count = 0;

    const Point3D &query =
        points[index];

    for (int dx = -1;
         dx <= 1;
         dx++)
    {
        for (int dy = -1;
             dy <= 1;
             dy++)
        {
            for (int dz = -1;
                 dz <= 1;
                 dz++)
            {
                int nx = cx + dx;
                int ny = cy + dy;
                int nz = cz + dz;

                uint32_t hash =
                    gridHash(
                        nx,
                        ny,
                        nz
                    );

                int current =
                    gridHead[hash];

                while (current != -1)
                {
                    if (
                        cellX[current] == nx &&
                        cellY[current] == ny &&
                        cellZ[current] == nz
                    )
                    {
                        if (
                            squaredDistance(
                                query,
                                points[current]
                            ) <= EPSILON2
                        )
                        {
                            count++;

                            if (
                                count >= MIN_PTS
                            )
                            {
                                return count;
                            }
                        }
                    }

                    current =
                        gridNext[current];
                }
            }
        }
    }

    return count;
}


// ============================================================
// Core-point detection
// ============================================================

int detectCorePoints(int N)
{
    int coreCount = 0;

    for (int i = 0;
         i < N;
         i++)
    {
        int neighbors =
            gridCountNeighbors(i);

        if (neighbors >= MIN_PTS)
        {
            coreFlags[i] = 1;
            coreCount++;
        }
        else
        {
            coreFlags[i] = 0;
        }
    }

    return coreCount;
}


// ============================================================
// Baseline neighbor expansion
// ============================================================

void serialAddNeighbors(
    int index,
    int clusterId,
    int N,
    int *labels,
    int *queue,
    int &queueSize
)
{
    int cx = cellX[index];
    int cy = cellY[index];
    int cz = cellZ[index];

    const Point3D &query =
        points[index];

    for (int dx = -1;
         dx <= 1;
         dx++)
    {
        for (int dy = -1;
             dy <= 1;
             dy++)
        {
            for (int dz = -1;
                 dz <= 1;
                 dz++)
            {
                int nx = cx + dx;
                int ny = cy + dy;
                int nz = cz + dz;

                uint32_t hash =
                    gridHash(
                        nx,
                        ny,
                        nz
                    );

                int current =
                    gridHead[hash];

                while (current != -1)
                {
                    if (
                        cellX[current] == nx &&
                        cellY[current] == ny &&
                        cellZ[current] == nz
                    )
                    {
                        if (
                            squaredDistance(
                                query,
                                points[current]
                            ) <= EPSILON2
                        )
                        {
                            if (labels[current] == 0)
                            {
                                labels[current] =
                                    clusterId;

                                if (
                                    queueSize < N
                                )
                                {
                                    queue[
                                        queueSize++
                                    ] = current;
                                }
                            }
                        }
                    }

                    current =
                        gridNext[current];
                }
            }
        }
    }
}


// ============================================================
// Baseline DBSCAN
// ============================================================

void runBaselineDBSCAN(
    int N,
    int *labels,
    int *queue
)
{
    for (int i = 0;
         i < N;
         i++)
    {
        labels[i] = 0;
    }

    int clusterId = 0;

    for (int i = 0;
         i < N;
         i++)
    {
        if (labels[i] != 0)
        {
            continue;
        }

        if (!coreFlags[i])
        {
            labels[i] = -2;
            continue;
        }

        clusterId++;

        int queueSize = 0;
        int queuePosition = 0;

        labels[i] =
            clusterId;

        serialAddNeighbors(
            i,
            clusterId,
            N,
            labels,
            queue,
            queueSize
        );

        while (
            queuePosition < queueSize
        )
        {
            int current =
                queue[
                    queuePosition++
                ];

            if (coreFlags[current])
            {
                serialAddNeighbors(
                    current,
                    clusterId,
                    N,
                    labels,
                    queue,
                    queueSize
                );
            }
        }
    }
}


// ============================================================
// Parallel neighbor expansion
//
// Only the label claim is synchronized.
// Each core writes to its own next-frontier buffer.
// ============================================================

void parallelAddNeighbors(
    int index,
    int clusterId,
    int *labels,
    int *localNext,
    int &localNextSize
)
{
    int cx = cellX[index];
    int cy = cellY[index];
    int cz = cellZ[index];

    const Point3D &query =
        points[index];

    for (int dx = -1;
         dx <= 1;
         dx++)
    {
        for (int dy = -1;
             dy <= 1;
             dy++)
        {
            for (int dz = -1;
                 dz <= 1;
                 dz++)
            {
                int nx = cx + dx;
                int ny = cy + dy;
                int nz = cz + dz;

                uint32_t hash =
                    gridHash(
                        nx,
                        ny,
                        nz
                    );

                int current =
                    gridHead[hash];

                while (current != -1)
                {
                    if (
                        cellX[current] == nx &&
                        cellY[current] == ny &&
                        cellZ[current] == nz
                    )
                    {
                        if (
                            squaredDistance(
                                query,
                                points[current]
                            ) <= EPSILON2
                        )
                        {
                            bool claimed = false;

                            portENTER_CRITICAL(
                                &labelMux
                            );

                            if (
                                labels[current] == 0
                            )
                            {
                                labels[current] =
                                    clusterId;

                                claimed = true;
                            }

                            portEXIT_CRITICAL(
                                &labelMux
                            );

                            if (claimed)
                            {
                                if (
                                    localNextSize < MAX_N
                                )
                                {
                                    localNext[
                                        localNextSize++
                                    ] = current;
                                }
                            }
                        }
                    }

                    current =
                        gridNext[current];
                }
            }
        }
    }
}


// ============================================================
// Core 1 worker
// ============================================================

void dualWorkerTask(
    void *parameter
)
{
    (void)parameter;

    bool printedCPU = false;

    while (true)
    {
        // Wait until Core 0 sends work.
        ulTaskNotifyTake(
            pdTRUE,
            portMAX_DELAY
        );

        if (!printedCPU)
        {
            Serial.printf(
                "Core 1 worker running on CPU %d\n",
                xPortGetCoreID()
            );

            printedCPU = true;
        }

        workerNextSize = 0;

        // Process Core 1's half of current frontier.
        for (
            int pos = workerStart;
            pos < workerEnd;
            pos++
        )
        {
            int current =
                workerFrontier[pos];

            if (coreFlags[current])
            {
                int localSize =
                    workerNextSize;

                parallelAddNeighbors(
                    current,
                    workerClusterId,
                    dualLabels,
                    dualNext1,
                    localSize
                );

                workerNextSize =
                    localSize;
            }
        }

        // Wake Core 0.
        xTaskNotifyGive(
            experimentHandle
        );
    }
}


// ============================================================
// Parallel cluster expansion
// ============================================================

void parallelExpandCluster(
    int seed,
    int clusterId
)
{
    int frontierSize = 1;

    dualQueue[0] =
        seed;

    dualLabels[seed] =
        clusterId;

    while (frontierSize > 0)
    {
        int nextSize0 = 0;

        workerNextSize = 0;

        // ----------------------------------------------------
        // Small frontier:
        // serial execution is cheaper.
        // ----------------------------------------------------

        if (
            frontierSize <
            PARALLEL_THRESHOLD
        )
        {
            for (
                int pos = 0;
                pos < frontierSize;
                pos++
            )
            {
                int current =
                    dualQueue[pos];

                if (coreFlags[current])
                {
                    parallelAddNeighbors(
                        current,
                        clusterId,
                        dualLabels,
                        dualNext0,
                        nextSize0
                    );
                }
            }

            frontierSize =
                nextSize0;

            for (
                int i = 0;
                i < frontierSize;
                i++
            )
            {
                dualQueue[i] =
                    dualNext0[i];
            }

            continue;
        }

        // ----------------------------------------------------
        // Split frontier
        // ----------------------------------------------------

        int midpoint =
            frontierSize / 2;

        workerFrontier =
            dualQueue;

        workerStart =
            midpoint;

        workerEnd =
            frontierSize;

        workerClusterId =
            clusterId;

        workerNextSize = 0;

        // ----------------------------------------------------
        // Launch Core 1
        // ----------------------------------------------------

        xTaskNotifyGive(
            workerHandle
        );

        // ----------------------------------------------------
        // Core 0 processes first half
        // ----------------------------------------------------

        for (
            int pos = 0;
            pos < midpoint;
            pos++
        )
        {
            int current =
                dualQueue[pos];

            if (coreFlags[current])
            {
                parallelAddNeighbors(
                    current,
                    clusterId,
                    dualLabels,
                    dualNext0,
                    nextSize0
                );
            }
        }

        // ----------------------------------------------------
        // Wait for Core 1
        // ----------------------------------------------------

        ulTaskNotifyTake(
            pdTRUE,
            portMAX_DELAY
        );

        // ----------------------------------------------------
        // Merge next frontier
        // ----------------------------------------------------

        frontierSize = 0;

        for (
            int i = 0;
            i < nextSize0;
            i++
        )
        {
            if (
                frontierSize < MAX_N
            )
            {
                dualQueue[
                    frontierSize++
                ] =
                    dualNext0[i];
            }
        }

        for (
            int i = 0;
            i < workerNextSize;
            i++
        )
        {
            if (
                frontierSize < MAX_N
            )
            {
                dualQueue[
                    frontierSize++
                ] =
                    dualNext1[i];
            }
        }
    }
}


// ============================================================
// Dual-Core DBSCAN
// ============================================================

void runDualCoreDBSCAN(int N)
{
    for (int i = 0;
         i < N;
         i++)
    {
        dualLabels[i] = 0;
    }

    int clusterId = 0;

    for (int i = 0;
         i < N;
         i++)
    {
        if (dualLabels[i] != 0)
        {
            continue;
        }

        if (!coreFlags[i])
        {
            dualLabels[i] = -2;
            continue;
        }

        clusterId++;

        parallelExpandCluster(
            i,
            clusterId
        );
    }
}


// ============================================================
// Statistics
// ============================================================

DBSCANStats calculateStats(
    int N,
    int *labels
)
{
    DBSCANStats stats{};

    int maxCluster = 0;

    for (int i = 0;
         i < N;
         i++)
    {
        if (labels[i] == -2)
        {
            stats.noise++;
        }
        else if (
            labels[i] > maxCluster
        )
        {
            maxCluster =
                labels[i];
        }
    }

    stats.clusters =
        maxCluster;

    for (int i = 0;
         i < N;
         i++)
    {
        if (labels[i] <= 0)
        {
            continue;
        }

        if (coreFlags[i])
        {
            stats.core++;
        }
        else
        {
            stats.border++;
        }
    }

    return stats;
}


// ============================================================
// Exact label comparison
// ============================================================

int compareLabels(
    int N,
    int *a,
    int *b
)
{
    int different = 0;

    for (int i = 0;
         i < N;
         i++)
    {
        if (a[i] != b[i])
        {
            different++;
        }
    }

    return different;
}


// ============================================================
// Memory information
// ============================================================

void printMemoryInfo()
{
    size_t pointsMemory =
        sizeof(Point3D) * MAX_N;

    size_t labelsMemory =
        sizeof(int) * MAX_N * 2;

    size_t coreMemory =
        sizeof(uint8_t) * MAX_N;

    size_t queueMemory =
        sizeof(int) * MAX_N * 4;

    size_t gridHeadMemory =
        sizeof(int) * GRID_BUCKETS;

    size_t gridNextMemory =
        sizeof(int) * MAX_N;

    size_t cellMemory =
        sizeof(int) * MAX_N * 3;

    size_t total =
        pointsMemory +
        labelsMemory +
        coreMemory +
        queueMemory +
        gridHeadMemory +
        gridNextMemory +
        cellMemory;

    Serial.printf(
        "Comparison buffers: %.2f KB\n",
        total / 1024.0f
    );

    Serial.printf(
        "Free heap: %u bytes\n",
        ESP.getFreeHeap()
    );

    Serial.printf(
        "Free PSRAM: %u bytes\n",
        ESP.getFreePsram()
    );
}


// ============================================================
// Experiment task
//
// Explicitly pinned to Core 0.
// ============================================================

void experimentTask(
    void *parameter
)
{
    (void)parameter;

    experimentHandle =
        xTaskGetCurrentTaskHandle();

    Serial.printf(
        "Experiment task running on CPU %d\n",
        xPortGetCoreID()
    );

    Serial.println();

    Serial.println(
        "=============================================="
    );

    Serial.println(
        "Configuration"
    );

    Serial.println(
        "Dimensions: 3"
    );

    Serial.printf(
        "Epsilon: %.2f\n",
        EPSILON
    );

    Serial.printf(
        "MinPts: %d\n",
        MIN_PTS
    );

    Serial.printf(
        "Grid buckets: %d\n",
        GRID_BUCKETS
    );

    Serial.printf(
        "Cluster radius: %.2f\n",
        CLUSTER_RADIUS
    );

    Serial.printf(
        "Parallel threshold: %d\n",
        PARALLEL_THRESHOLD
    );

    Serial.println();

    printMemoryInfo();

    Serial.println();


    // ========================================================
    // Test sizes
    // ========================================================

    const int testSizes[] =
    {
        180,
        360,
        720,
        1080,
        1440
    };

    const int testCount =
        sizeof(testSizes) /
        sizeof(testSizes[0]);


    // ========================================================
    // Tests
    // ========================================================

    for (
        int t = 0;
        t < testCount;
        t++
    )
    {
        int N =
            testSizes[t];

        Serial.println();

        Serial.println(
            "----------------------------------------------"
        );

        Serial.printf(
            "N = %d\n",
            N
        );


        // ----------------------------------------------------
        // Generate dataset
        // ----------------------------------------------------

        Serial.println(
            "Generating deterministic dataset..."
        );

        generateDataset(N);


        // ----------------------------------------------------
        // Build grid
        // ----------------------------------------------------

        Serial.println(
            "Building spatial grid..."
        );

        uint64_t gridStart =
            esp_timer_get_time();

        buildGrid(N);

        uint64_t gridEnd =
            esp_timer_get_time();

        double gridMs =
            (gridEnd - gridStart) /
            1000.0;


        // ----------------------------------------------------
        // Detect core points
        // ----------------------------------------------------

        Serial.println(
            "Detecting core points..."
        );

        uint64_t coreStart =
            esp_timer_get_time();

        int coreCount =
            detectCorePoints(N);

        uint64_t coreEnd =
            esp_timer_get_time();

        double coreDetectionMs =
            (coreEnd - coreStart) /
            1000.0;


        // ====================================================
        // Baseline
        // ====================================================

        Serial.println(
            "Running single-core expansion..."
        );

        uint64_t baselineStart =
            esp_timer_get_time();

        runBaselineDBSCAN(
            N,
            baselineLabels,
            baselineQueue
        );

        uint64_t baselineEnd =
            esp_timer_get_time();

        double baselineExpansionMs =
            (baselineEnd - baselineStart) /
            1000.0;


        // ====================================================
        // Dual-Core
        // ====================================================

        Serial.println(
            "Running dual-core expansion..."
        );

        uint64_t dualStart =
            esp_timer_get_time();

        runDualCoreDBSCAN(
            N
        );

        uint64_t dualEnd =
            esp_timer_get_time();

        double dualExpansionMs =
            (dualEnd - dualStart) /
            1000.0;


        // ====================================================
        // Total
        // ====================================================

        double baselineTotal =
            gridMs +
            coreDetectionMs +
            baselineExpansionMs;

        double dualTotal =
            gridMs +
            coreDetectionMs +
            dualExpansionMs;


        // ====================================================
        // Speedup
        // ====================================================

        double expansionSpeedup =
            baselineExpansionMs /
            dualExpansionMs;

        double expansionImprovement =
            (
                (baselineExpansionMs -
                 dualExpansionMs) /
                baselineExpansionMs
            ) * 100.0;

        double totalSpeedup =
            baselineTotal /
            dualTotal;

        double totalImprovement =
            (
                (baselineTotal -
                 dualTotal) /
                baselineTotal
            ) * 100.0;


        // ====================================================
        // Statistics
        // ====================================================

        DBSCANStats baselineStats =
            calculateStats(
                N,
                baselineLabels
            );

        DBSCANStats dualStats =
            calculateStats(
                N,
                dualLabels
            );


        // ====================================================
        // Correctness
        // ====================================================

        int different =
            compareLabels(
                N,
                baselineLabels,
                dualLabels
            );


        // ====================================================
        // Output
        // ====================================================

        Serial.println();

        Serial.printf(
            "Grid build: %.3f ms\n",
            gridMs
        );

        Serial.printf(
            "Core detection: %.3f ms\n",
            coreDetectionMs
        );

        Serial.printf(
            "Core points: %d\n",
            coreCount
        );

        Serial.println();

        Serial.printf(
            "Baseline expansion: %.3f ms\n",
            baselineExpansionMs
        );

        Serial.printf(
            "Dual-Core expansion: %.3f ms\n",
            dualExpansionMs
        );

        Serial.printf(
            "Expansion speedup: %.2fx\n",
            expansionSpeedup
        );

        Serial.printf(
            "Expansion improvement: %.2f%%\n",
            expansionImprovement
        );

        Serial.println();

        Serial.printf(
            "Baseline total: %.3f ms\n",
            baselineTotal
        );

        Serial.printf(
            "Dual-Core total: %.3f ms\n",
            dualTotal
        );

        Serial.printf(
            "End-to-end speedup: %.2fx\n",
            totalSpeedup
        );

        Serial.printf(
            "End-to-end improvement: %.2f%%\n",
            totalImprovement
        );

        Serial.println();

        Serial.printf(
            "Clusters: %d / %d\n",
            baselineStats.clusters,
            dualStats.clusters
        );

        Serial.printf(
            "Core: %d / %d\n",
            baselineStats.core,
            dualStats.core
        );

        Serial.printf(
            "Border: %d / %d\n",
            baselineStats.border,
            dualStats.border
        );

        Serial.printf(
            "Noise: %d / %d\n",
            baselineStats.noise,
            dualStats.noise
        );

        Serial.printf(
            "Different labels: %d\n",
            different
        );

        if (different == 0)
        {
            Serial.println(
                "IDENTICAL"
            );
        }
        else
        {
            Serial.println(
                "WARNING: RESULTS DIFFER"
            );
        }

        Serial.println(
            "----------------------------------------------"
        );
    }


    // ========================================================
    // Finished
    // ========================================================

    Serial.println();

    Serial.println(
        "Experiment D completed."
    );

    Serial.println(
        "=============================================="
    );

    while (true)
    {
        vTaskDelay(
            pdMS_TO_TICKS(1000)
        );
    }
}


// ============================================================
// Setup
// ============================================================

void setup()
{
    Serial.begin(115200);

    delay(2000);

    Serial.println();

    Serial.println(
        "=============================================="
    );

    Serial.println(
        "ESP32-S3 DBSCAN"
    );

    Serial.println(
        "Experiment D"
    );

    Serial.println(
        "Parallel Cluster Expansion"
    );

    Serial.println(
        "=============================================="
    );

    Serial.printf(
        "CPU frequency: %u MHz\n",
        getCpuFrequencyMhz()
    );

    Serial.printf(
        "Setup CPU: %d\n",
        xPortGetCoreID()
    );

    Serial.printf(
        "Free heap: %u bytes\n",
        ESP.getFreeHeap()
    );

    Serial.printf(
        "Free PSRAM: %u bytes\n",
        ESP.getFreePsram()
    );


    // ========================================================
    // Allocate PSRAM
    // ========================================================

    points =
        (Point3D *)ps_malloc(
            sizeof(Point3D) * MAX_N
        );

    baselineLabels =
        (int *)ps_malloc(
            sizeof(int) * MAX_N
        );

    dualLabels =
        (int *)ps_malloc(
            sizeof(int) * MAX_N
        );

    coreFlags =
        (uint8_t *)ps_malloc(
            sizeof(uint8_t) * MAX_N
        );

    baselineQueue =
        (int *)ps_malloc(
            sizeof(int) * MAX_N
        );

    dualQueue =
        (int *)ps_malloc(
            sizeof(int) * MAX_N
        );

    dualNext0 =
        (int *)ps_malloc(
            sizeof(int) * MAX_N
        );

    dualNext1 =
        (int *)ps_malloc(
            sizeof(int) * MAX_N
        );


    // ========================================================
    // Grid buffers
    // ========================================================

    gridHead =
        (int *)ps_malloc(
            sizeof(int) * GRID_BUCKETS
        );

    gridNext =
        (int *)ps_malloc(
            sizeof(int) * MAX_N
        );

    cellX =
        (int *)ps_malloc(
            sizeof(int) * MAX_N
        );

    cellY =
        (int *)ps_malloc(
            sizeof(int) * MAX_N
        );

    cellZ =
        (int *)ps_malloc(
            sizeof(int) * MAX_N
        );


    // ========================================================
    // Allocation check
    // ========================================================

    if (
        !points ||
        !baselineLabels ||
        !dualLabels ||
        !coreFlags ||
        !baselineQueue ||
        !dualQueue ||
        !dualNext0 ||
        !dualNext1 ||
        !gridHead ||
        !gridNext ||
        !cellX ||
        !cellY ||
        !cellZ
    )
    {
        Serial.println(
            "ERROR: PSRAM allocation failed!"
        );

        while (true)
        {
            delay(1000);
        }
    }

    Serial.println(
        "PSRAM buffers allocated successfully."
    );


    // ========================================================
    // Core 1 worker
    // ========================================================

    BaseType_t workerResult =
        xTaskCreatePinnedToCore(
            dualWorkerTask,
            "DBSCANWorker",
            8192,
            nullptr,
            2,
            &workerHandle,
            1
        );

    if (workerResult != pdPASS)
    {
        Serial.println(
            "ERROR: Core 1 worker creation failed!"
        );

        while (true)
        {
            delay(1000);
        }
    }

    Serial.println(
        "Core 1 worker created."
    );


    // ========================================================
    // Benchmark task on Core 0
    // ========================================================

    BaseType_t experimentResult =
        xTaskCreatePinnedToCore(
            experimentTask,
            "DBSCANExperiment",
            12288,
            nullptr,
            2,
            &experimentHandle,
            0
        );

    if (experimentResult != pdPASS)
    {
        Serial.println(
            "ERROR: Experiment task creation failed!"
        );

        while (true)
        {
            delay(1000);
        }
    }

    Serial.println(
        "Experiment task created on Core 0."
    );
}


// ============================================================
// Loop
// ============================================================

void loop()
{
    delay(1000);
}